## conf/machine/bootlinlabs.conf
```bitbake
#@TYPE: Machine
#@NAME: BeagleBone machine
#@DESCRIPTION: Machine configuration for the http://beagleboard.org/bone board

require conf/machine/include/ti-soc.inc
SOC_FAMILY:append = ":ti33x"

DEFAULTTUNE = "cortexa8thf-neon"
require conf/machine/include/arm/armv7a/tune-cortexa8.inc

KERNEL_DEVICETREE = "am335x-boneblack.dtb"
PREFERRED_PROVIDER_virtual/kernel = "linux-ti-staging"
KERNEL_IMAGETYPE = "zImage"

LINUX_KERNEL_TYPE = "preempt-rt"

PREFERRED_PROVIDER_virtual/bootloader = "u-boot-ti-staging"
UBOOT_ARCH = "arm"
UBOOT_MACHINE = "am335x_evm_config"
UBOOT_ENTRYPOINT = "0x80008000"
UBOOT_LOADADDRESS = "0x80008000"

MACHINE_GUI_CLASS = "bigscreen"
MACHINE_FEATURES += "screen"
MACHINE_ESSENTIAL_EXTRA_RDEPENDS += "kernel-devicetree kernel-image-zimage"
MACHINE_FEATURES = "apm usbgadget usbhost vfat ext2 alsa"

SERIAL_CONSOLES = "115200;ttyS0"
```
